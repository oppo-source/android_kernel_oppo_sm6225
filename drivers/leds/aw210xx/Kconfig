## drivers/leds/aw210xx/Kconfig
```kconfig
config AW_BREATH_ALGORITHM
	tristate "LED Support for AW210XX"
	depends on LEDS_CLASS && I2C
	help
	  this option enables support for the AW210XXRGB LED connected
	  through I2C. Say Y to enable support for the AW210XX LED
	  light automatically.
	  
config AW_LAMP_INTERFACE
	tristate "LED Support for AW210XX"
	depends on LEDS_CLASS && I2C
	help
	  this option enables support for the AW210XXRGB LED connected
	  through I2C. Say Y to enable support for the AW210XX LED
	  light automatically.
	  
config LEDS_AW210XX
	tristate "LED Support for AW210XX"
	depends on LEDS_CLASS && I2C
	help
	  this option enables support for the AW210XXRGB LED connected
	  through I2C. Say Y to enable support for the AW210XX LED
	  light automatically.
```

## drivers/misc/ocp2130_bias/Kconfig
```kconfig
#
# OCP2130 bias IC driver configuration
#

config OCP2130_BIAS
	tristate "OCP2130 bias IC"
	depends on I2C
	default m
	help
	  Say Y here if you have OCP2130 bias IC.
	  If unsure, say N.
```

## drivers/power/Kconfig
```kconfig
# SPDX-License-Identifier: GPL-2.0-only
source "drivers/power/reset/Kconfig"
source "drivers/power/supply/Kconfig"

#ifdef OPLUS_FEATURE_CHG_BASIC
config OPLUS_CHG
	tristate "OPLUS CHARGER KO module"
	default m
	help
	  Enables support for the oplus charging framework

config OPLUS_SM6115R_CHARGER
	bool "OPLUS SM6115 charger driver"
	default n
	help
	  Enables support for the oplus charging framework

config OPLUS_CHG_TEST_KIT
	tristate "Charger Test Kit"
	default n
	help
	  Say Y or M to enable tesk kit

config OPLUS_SHORT_C_BATT_CHECK
	bool "OPLUS_SHORT_C_BATT CHECK SUPPORT"
	default n
	help
	  Say Y to include support

config OPLUS_CALL_MODE_SUPPORT
	bool "OPLUS call mode support"
	help
	  Say Y to include support

config OPLUS_SMART_CHARGER_SUPPORT
	bool "OPLUS smart charger support"
	help
	  Say Y to include support

config OPLUS_SHORT_HW_CHECK
	bool "OPLUS_SHORT_HW CHECK SUPPORT"
	default n
	help
	  Say Y to include support

config OPLUS_CHIP_SOC_NODE
	bool "OPLUS chip soc node"
	help
	  Say Y to include support

config OPLUS_SHORT_IC_CHECK
	bool "OPLUS_SHORT_IC CHECK SUPPORT"
	default n
	help
	  Say Y to include support

config OPLUS_SHORT_USERSPACE
	bool "OPLUS batt userspace"
	help
	 Say Y to include support

config OPLUS_RTC_DET_SUPPORT
	bool "OPLUS RTC DET SUPPORT"
	default n
	help
	  Say Y to include support

config OPLUS_CHECK_CHARGERID_VOLT
	bool "OPLUS CHECK CHARGERID VOLT"
	default n
	help
	  Say Y to include support

config OPLUS_SHIP_MODE_SUPPORT
	bool "OPLUS_SHIP_MODE_SUPPORT"
	default n
	help
	  Say Y to include support

config OPLUS_CHG_DYNAMIC_CONFIG
	bool "OPLUS_CHG_DYNAMIC_CONFIG"
	default n
	help
	  Say Y to include support

config DISABLE_OPLUS_FUNCTION
	bool "DISABLE_OPLUS_FUNCTION for bringup compile"
	default n
	help
	  Say Y to include support

config OPLUS_CHG_DRM_PANEL_NOTIFY
	bool "OPLUS_CHG_DRM_PANEL_NOTIFY"
	default n
	help
	  Say Y to include support

config OPLUS_AUDIO_SWITCH_GLINK
	bool "OPLUS_AUDIO_SWITCH_GLINK"
	default n
	help
	  Say Y to include support

config OPLUS_PD_EXT_SUPPORT
	bool "TypeC Port Controller Extern"
	default n
	help
	  Say Y to enable

source "drivers/power/oplus/Kconfig"

if OPLUS_PD_EXT_SUPPORT
source "drivers/power/oplus/pd_ext/Kconfig"
endif

menuconfig OPLUS_CHG_V2
	tristate "OPLUS charging V2 system"
	default n
	depends on I2C
	select REGMAP_I2C
	help
	  Say Y here to enable OPLUS charging V2 system support

if OPLUS_CHG_V2
config OPLUS_SMART_CHARGE
	bool "smart charge"
	help
	  Say Y here to enable smart charge

config OPLUS_CHG_IC_DEBUG
	bool "Virtual IC layer debug interface"
	help
	  Say Y here to declare virtual IC layer debug interface

config OPLUS_CHG_MMS_DEBUG
	bool "Message subscription layer debug interface"
	help
	  Say Y here to declare message subscription layer debug interface

config OPLUS_PD_MANAGER_CHARGER
	bool "PD_MANAGER support"
	help
	  Say Y here to declare PD_MANAGER support

config OPLUS_UFCS_CLASS
	tristate "oplus ufcs class"
	default n
	help
	  Say Y or M to enable oplus ufcs class

config OPLUS_SC6607_CHARGER
	bool "oplus sc6607 charger"
	help
	  Say Y or M to enable oplus sc6607 charger

menuconfig OPLUS_CHG_VOOCPHY
	bool "OPLUS charging voocphy"
	help
	  Say Y here to enable OPLUS charging system support

if OPLUS_CHG_VOOCPHY
config OPLUS_CHG_VOOCPHY_CHGLIB
	bool "voocphy chglib support"
	help
	  Say Y here to declare voocphy chglib support

config OPLUS_CHG_AP_VOOCPHY
	bool "ap voocphy support"
	depends on OPLUS_CHG_VOOCPHY_CHGLIB
	help
          Say Y here to declare ap voocphy support
endif #OPLUS_CHG_VOOCPHY
endif
#endif
```

## drivers/soc/Kconfig
```kconfig
menu "SOC (System On Chip) specific Drivers"

source "drivers/soc/actions/Kconfig"
source "drivers/soc/amlogic/Kconfig"
source "drivers/soc/atmel/Kconfig"
source "drivers/soc/bcm/Kconfig"
source "drivers/soc/fsl/Kconfig"
source "drivers/soc/imx/Kconfig"
source "drivers/soc/mediatek/Kconfig"
source "drivers/soc/qcom/Kconfig"
source "drivers/soc/renesas/Kconfig"
source "drivers/soc/rockchip/Kconfig"
source "drivers/soc/samsung/Kconfig"
source "drivers/soc/sunxi/Kconfig"
source "drivers/soc/tegra/Kconfig"
source "drivers/soc/ti/Kconfig"
source "drivers/soc/ux500/Kconfig"
source "drivers/soc/versatile/Kconfig"
source "drivers/soc/xilinx/Kconfig"
source "drivers/soc/zte/Kconfig"
source "drivers/soc/oplus/Kconfig"

#ifdef OPLUS_FEATURE_IOMONITOR
source "drivers/soc/oplus/iomonitor/Kconfig"
#endif /*OPLUS_FEATURE_IOMONITOR*/

#ifdef OPLUS_FEATURE_POWERINFO_STANDBY
#add for feature powerinfo standby.
source "drivers/soc/oplus/oplus_wakelock/Kconfig"
#endif /* OPLUS_FEATURE_POWERINFO_STANDBY */

#ifdef VENDOR_EDIT
#wen.luo@BSP.Kernel.Stability 2020/03/25 add for oplus kernel system
source "drivers/soc/oplus/system/Kconfig"
#endif /* VENDOR_EDIT */

#ifdef OPLUS_FEATURE_SENSOR_SMEM
#qiuzuolin@BSP.Sensor.Basic 2020/07/31 add for oplus sensor smem
source "drivers/soc/oplus/sensor/Kconfig"
#endif /* OPLUS_FEATURE_SENSOR_SMEM */
#ifdef OPLUS_FEATURE_HEALTHINFO
#Jiheng.Xie@BSP.Kernel.Performance 2020/06/18 add for oppo healthinfo
source "drivers/soc/oplus/healthinfo/Kconfig"
#endif /* OPLUS_FEATURE_HEALTHINFO */

#Add for NandSwap
source "drivers/soc/oplus/oplus_nandswap/Kconfig"
#ifdef OPLUS_FEATURE_MEMLEAK_DETECT
#Add for svelte
source "drivers/soc/oplus/svelte/Kconfig"
#endif /* OPLUS_FEATURE_MEMLEAK_DETECT */

endmenu
```
